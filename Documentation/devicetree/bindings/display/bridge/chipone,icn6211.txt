## Documentation/devicetree/bindings/display/bridge/chipone,icn6211.txt
```
Chipone ICN6211 MIPI-DSI to RGB Convertor Bridge

ICN6211 is MIPI-DSI/RGB converter bridge from chipone.
It has a flexible configuration of MIPI DSI signal input
and produce RGB565, RGB666, RGB888 output format.

Required properties for RGB:
- compatible: must be "chipone,icn6211" and one of:
  * "bananapi,icn6211"
- reg: the virtual channel number of a DSI peripheral
- reset-gpios: a GPIO phandle for the reset pin

The device node can contain following 'port' child nodes,
according to the OF graph bindings defined in [1]:
  0: DSI Input, not required, if the bridge is DSI controlled
  1: RGB Output, mandatory

[1]: Documentation/devicetree/bindings/media/video-interfaces.txt

Example:

	bridge@0 {
		compatible = "bananapi,icn6211", "chipone,icn6211";
		reg = <0>;
		reset-gpios = <&pio 3 6 GPIO_ACTIVE_HIGH>; /* LCD-RST: PD6 */
		#address-cells = <1>;
		#size-cells = <0>;

		port@1 {
			reg = <1>;

			bridge_out_ep: endpoint {
				remote-endpoint = <&panel_ep>;
			};
		};
	};
```

## Documentation/devicetree/bindings/display/panel/novatek,nt35596.txt
```
Novatek NT35596 based LCD panels

Novatek NT35596 is a single-chip IC solution for small or medium-sized
LTPS TFT LCD panels. NT35596 provides  several system interfaces like
MIPI/SPI/I2C.

Microtech MTF050FHDI-03 is 1080x1920, 4-lane MIPI DSI LCD panel which
has inbuilt NT35596 IC chip.

Required properties:
- compatible: must be "novatek,nt35596" and one of
  * "microtech,mtf050fhdi-03"
- reset-gpios: a GPIO phandle for the reset pin

Required properties for microtech,mtf050fhdi-03:
- reg: DSI virtual channel used by that screen
- dvdd-supply: I/O system regulator
- avdd-supply: analog regulator for MIPI circuit
- avee-supply: analog regulator for MIPI circuit

Optional properties:
- backlight: phandle for the backlight control.

panel@0 {
	compatible = "microtech,mtf050fhdi-03", "novatek,nt35596";
	reg = <0>;
	dvdd-supply = <&reg_dldo2>;	/* VCC-MIPI */
	avdd-supply = <&reg_dc1sw>;	/* AVDD_5V0 */
	avee-supply = <&reg_dc1sw>;	/* AVEE_5V */
	reset-gpios = <&pio 3 24 GPIO_ACTIVE_HIGH>; /* LCD-RST: PD24 */
	backlight = <&backlight>;
};
```
